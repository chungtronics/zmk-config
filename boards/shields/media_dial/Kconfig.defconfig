## boards/shields/media_dial/Kconfig.defconfig
```kconfig
# SPDX-License-Identifier: MIT

if SHIELD_MEDIA_DIAL

config ZMK_KEYBOARD_NAME
    default "KeviX Dial"

endif # SHIELD_MEDIA_DIAL
```

## boards/shields/media_dial/Kconfig.shield
```kconfig
# SPDX-License-Identifier: MIT

config SHIELD_MEDIA_DIAL
    def_bool $(shields_list_contains,media_dial)
```

## boards/shields/media_dial_noenc/Kconfig.shield
```kconfig
# SPDX-License-Identifier: MIT

config SHIELD_MEDIA_DIAL_NOENC
    def_bool $(shields_list_contains,media_dial_noenc)
```
