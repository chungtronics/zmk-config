/*
 * SPDX-License-Identifier: MIT
 *
 * Ban go loi cua media_dial: KHONG co encoder, khong co driver EC11.
 * Chi con dung 1 phim mute tren D4 (P0.22) de kiem tra BLE co on dinh khong.
 */

/ {
    chosen {
        zmk,kscan = &kscan0;
    };

    kscan0: kscan_0 {
        compatible = "zmk,kscan-gpio-direct";
        wakeup-source;

        input-gpios = <&pro_micro 4 (GPIO_ACTIVE_LOW | GPIO_PULL_UP)>;
    };
};
